## br2_external/dashboard_pi/Config.in
```kconfig
source "$BR2_EXTERNAL_DASHBOARD_PI_PATH/package/dashboard-pi-wpewebkit/Config.in"
source "$BR2_EXTERNAL_DASHBOARD_PI_PATH/package/dashboard-pi-launcher/Config.in"
source "$BR2_EXTERNAL_DASHBOARD_PI_PATH/package/dashboard-pi-runtime/Config.in"
```

## br2_external/dashboard_pi/configs/dashboard_pi_rpi2_defconfig
```kconfig
BR2_arm=y
BR2_cortex_a7=y
BR2_ARM_FPU_NEON_VFPV4=y
BR2_TOOLCHAIN_EXTERNAL=y
BR2_TOOLCHAIN_EXTERNAL_BOOTLIN=y
BR2_TOOLCHAIN_EXTERNAL_BOOTLIN_ARMV7_EABIHF_GLIBC_STABLE=y
BR2_DOWNLOAD_FORCE_CHECK_HASHES=y
BR2_INIT_SYSTEMD=y
BR2_INIT_SYSTEMD_VAR_FACTORY=y
BR2_PACKAGE_SYSTEMD_NETWORKD=y
BR2_PACKAGE_SYSTEMD_RESOLVED=y
BR2_PACKAGE_DASHBOARD_PI_RUNTIME=y
BR2_PACKAGE_BUSYBOX_SHOW_OTHERS=y
BR2_PACKAGE_XZ=y
BR2_PACKAGE_LIBDRM=y
BR2_PACKAGE_MESA3D=y
BR2_PACKAGE_MESA3D_GALLIUM_DRIVER_VC4=y
BR2_PACKAGE_MESA3D_OPENGL_ES=y
BR2_PACKAGE_LIBCEC=y
BR2_PACKAGE_RSYSLOG=y
BR2_LINUX_KERNEL=y
BR2_LINUX_KERNEL_CUSTOM_TARBALL=y
BR2_LINUX_KERNEL_CUSTOM_TARBALL_LOCATION="$(call github,raspberrypi,linux,21b410140c47ffab5668399f6f143c7d7b935c8b)/linux-21b410140c47ffab5668399f6f143c7d7b935c8b.tar.gz"
BR2_LINUX_KERNEL_DEFCONFIG="bcm2709"
BR2_LINUX_KERNEL_DTS_SUPPORT=y
BR2_LINUX_KERNEL_INTREE_DTS_NAME="broadcom/bcm2709-rpi-2-b broadcom/bcm2710-rpi-2-b"
BR2_LINUX_KERNEL_NEEDS_HOST_OPENSSL=y
BR2_PACKAGE_RPI_FIRMWARE=y
BR2_PACKAGE_RPI_FIRMWARE_BOOTCODE_BIN=y
BR2_PACKAGE_RPI_FIRMWARE_VARIANT_PI=y
BR2_PACKAGE_RPI_FIRMWARE_CONFIG_FILE="$(BR2_EXTERNAL_DASHBOARD_PI_PATH)/board/raspberrypi/rpi2/config.txt"
BR2_PACKAGE_RPI_FIRMWARE_CMDLINE_FILE="$(BR2_EXTERNAL_DASHBOARD_PI_PATH)/board/raspberrypi/rpi2/cmdline.txt"
# BR2_PACKAGE_RPI_FIRMWARE_INSTALL_DTB_OVERLAYS is not set
BR2_TARGET_ROOTFS_INITRAMFS=y
# BR2_TARGET_ROOTFS_TAR is not set
BR2_ROOTFS_POST_IMAGE_SCRIPT="$(BR2_EXTERNAL_DASHBOARD_PI_PATH)/board/raspberrypi/rpi2/post-image.sh"
BR2_PACKAGE_HOST_DOSFSTOOLS=y
BR2_PACKAGE_HOST_GENIMAGE=y
BR2_PACKAGE_HOST_MTOOLS=y
```

## br2_external/dashboard_pi/package/dashboard-pi-launcher/Config.in
```kconfig
config BR2_PACKAGE_DASHBOARD_PI_LAUNCHER
	bool "Dashboard Pi WPEPlatform launcher"
	depends on BR2_PACKAGE_DASHBOARD_PI_WPEWEBKIT
	help
	  Install the minimal fullscreen Dashboard Pi launcher.
	  It embeds WPE WebKit through WPEPlatform and runs on DRM/KMS.
```

## br2_external/dashboard_pi/package/dashboard-pi-runtime/Config.in
```kconfig
config BR2_PACKAGE_DASHBOARD_PI_RUNTIME
	bool "dashboard-pi runtime"
	depends on BR2_INIT_SYSTEMD
	help
	  Install the Dashboard Pi systemd units, networkd configuration,
	  URL discovery scripts, logging hooks, local fallback page and
	  volatile runtime layout.
```

## br2_external/dashboard_pi/package/dashboard-pi-wpewebkit/Config.in
```kconfig
config BR2_PACKAGE_DASHBOARD_PI_WPEWEBKIT
	bool "Dashboard Pi WPE WebKit"
	depends on BR2_PACKAGE_WPEWEBKIT_ARCH_SUPPORTS
	depends on !BR2_BINFMT_FLAT
	depends on !BR2_STATIC_LIBS
	depends on BR2_HOST_GCC_AT_LEAST_7
	depends on BR2_INSTALL_LIBSTDCPP
	depends on BR2_TOOLCHAIN_HAS_THREADS_NPTL
	depends on BR2_TOOLCHAIN_GCC_AT_LEAST_11
	depends on BR2_USE_WCHAR
	depends on BR2_PACKAGE_HAS_LIBGLES
	depends on BR2_PACKAGE_HAS_LIBEGL
	depends on BR2_PACKAGE_HAS_LIBGBM
	depends on BR2_PACKAGE_HAS_UDEV
	depends on !BR2_PACKAGE_WPEWEBKIT
	select BR2_HOST_CMAKE_AT_LEAST_3_20
	select BR2_PACKAGE_FONTCONFIG
	select BR2_PACKAGE_FREETYPE
	select BR2_PACKAGE_GSTREAMER1
	select BR2_PACKAGE_GSTREAMER1_INSTALL_TOOLS
	select BR2_PACKAGE_GST1_LIBAV
	select BR2_PACKAGE_GST1_PLUGINS_BAD
	select BR2_PACKAGE_GST1_PLUGINS_BAD_PLUGIN_AUDIOPARSERS
	select BR2_PACKAGE_GST1_PLUGINS_BAD_PLUGIN_DEBUGUTILS
	select BR2_PACKAGE_GST1_PLUGINS_BAD_PLUGIN_MPEGTSDEMUX
	select BR2_PACKAGE_GST1_PLUGINS_BAD_PLUGIN_SUBENC
	select BR2_PACKAGE_GST1_PLUGINS_BAD_PLUGIN_V4L2CODECS
	select BR2_PACKAGE_GST1_PLUGINS_BAD_PLUGIN_VIDEOPARSERS
	select BR2_PACKAGE_GST1_PLUGINS_BASE
	select BR2_PACKAGE_GST1_PLUGINS_BASE_LIB_OPENGL
	select BR2_PACKAGE_GST1_PLUGINS_BASE_LIB_OPENGL_EGL
	select BR2_PACKAGE_GST1_PLUGINS_BASE_LIB_OPENGL_GLES2
	select BR2_PACKAGE_GST1_PLUGINS_BASE_PLUGIN_ALSA
	select BR2_PACKAGE_GST1_PLUGINS_BASE_PLUGIN_APP
	select BR2_PACKAGE_GST1_PLUGINS_BASE_PLUGIN_AUDIOCONVERT
	select BR2_PACKAGE_GST1_PLUGINS_BASE_PLUGIN_AUDIORESAMPLE
	select BR2_PACKAGE_GST1_PLUGINS_BASE_PLUGIN_OPUS
	select BR2_PACKAGE_GST1_PLUGINS_BASE_PLUGIN_PLAYBACK
	select BR2_PACKAGE_GST1_PLUGINS_BASE_PLUGIN_VIDEOCONVERTSCALE
	select BR2_PACKAGE_GST1_PLUGINS_BASE_PLUGIN_VOLUME
	select BR2_PACKAGE_GST1_PLUGINS_GOOD
	select BR2_PACKAGE_GST1_PLUGINS_GOOD_PLUGIN_AUDIOFX
	select BR2_PACKAGE_GST1_PLUGINS_GOOD_PLUGIN_AUTODETECT
	select BR2_PACKAGE_GST1_PLUGINS_GOOD_PLUGIN_ISOMP4
	select BR2_PACKAGE_GST1_PLUGINS_GOOD_PLUGIN_MATROSKA
	select BR2_PACKAGE_GST1_PLUGINS_GOOD_PLUGIN_RTSP
	select BR2_PACKAGE_GST1_PLUGINS_GOOD_PLUGIN_VPX
	select BR2_PACKAGE_HARFBUZZ
	select BR2_PACKAGE_ICU
	select BR2_PACKAGE_JPEG
	select BR2_PACKAGE_LIBDRM
	select BR2_PACKAGE_LIBEPOXY
	select BR2_PACKAGE_LIBGCRYPT
	select BR2_PACKAGE_LIBINPUT
	select BR2_PACKAGE_LIBPNG
	select BR2_PACKAGE_LIBSOUP3
	select BR2_PACKAGE_LIBTASN1
	select BR2_PACKAGE_LIBXKBCOMMON
	select BR2_PACKAGE_LIBXSLT
	select BR2_PACKAGE_WEBP
	select BR2_PACKAGE_WEBP_DEMUX
	select BR2_PACKAGE_WEBP_MUX
	help
	  Build the pinned WPE WebKit release used by Dashboard Pi.
	  It includes the WPEPlatform DRM/KMS implementation and the
	  production multimedia stack with GStreamer GL and ALSA.
	  The legacy libwpe API, wpebackend-fdo, Wayland display backend
	  and Cog are disabled.

	  This is separate from Buildroot's wpewebkit package because
	  Buildroot 2026.05 ships WPE WebKit 2.50 with the legacy API.

	  https://wpewebkit.org/

comment "Dashboard Pi WPE WebKit needs C++, wchar, NPTL, dynamic libraries, gcc >= 11 and host gcc >= 7"
	depends on BR2_PACKAGE_WPEWEBKIT_ARCH_SUPPORTS
	depends on !BR2_INSTALL_LIBSTDCPP || !BR2_USE_WCHAR \
		|| !BR2_TOOLCHAIN_HAS_THREADS_NPTL || BR2_STATIC_LIBS \
		|| !BR2_TOOLCHAIN_GCC_AT_LEAST_11 \
		|| !BR2_HOST_GCC_AT_LEAST_7

comment "Dashboard Pi WPE WebKit needs EGL, GLES, GBM and udev"
	depends on BR2_PACKAGE_WPEWEBKIT_ARCH_SUPPORTS
	depends on !BR2_PACKAGE_HAS_LIBGLES || !BR2_PACKAGE_HAS_LIBEGL \
		|| !BR2_PACKAGE_HAS_LIBGBM || !BR2_PACKAGE_HAS_UDEV
```
